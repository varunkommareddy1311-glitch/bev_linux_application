## meta-bev/conf/layer.conf
```bitbake
# meta-bev layer configuration

BBPATH .= ":${LAYERDIR}"

BBFILES += "${LAYERDIR}/recipes-*/*/*.bb \
            ${LAYERDIR}/recipes-*/*/*.bbappend"

BBFILE_COLLECTIONS += "bev"
BBFILE_PATTERN_bev = "^${LAYERDIR}/"
BBFILE_PRIORITY_bev = "10"

LAYERSERIES_COMPAT_bev = "kirkstone langdale mickledore nanbield scarthgap"

LAYERDEPENDS_bev = "core openembedded-layer"

# meta-bev packages against the distro-provided OpenCV recipe
# (meta-openembedded/meta-oe provides `opencv`).
```
